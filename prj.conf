## CMakeLists.txt
```
cmake_minimum_required(VERSION 3.20.0)

find_package(Zephyr REQUIRED HINTS $ENV{ZEPHYR_BASE})

project(ultimate_flipboard)

target_sources(app PRIVATE src/main.c src/scoreboard.c src/flipdots.c)
target_include_directories(app PRIVATE include)
```

## prj.conf
```kconfig
# Ultimate Flipboard — APP core (nRF54H20 cpuapp)

CONFIG_PRINTK=y

CONFIG_LOG=y
CONFIG_LOG_PROCESS_THREAD_PRIORITY=-15
CONFIG_LOG_PROCESS_THREAD_CUSTOM_PRIORITY=y

# GPIO for button inputs
CONFIG_GPIO=y

# UART for flipdots RS485 communication
CONFIG_SERIAL=y
CONFIG_UART_ASYNC_API=y
```

## boards/nrf54h20dk_nrf54h20_cpuapp.overlay
```dts
/*
 * Flipdots RS-485 via GPIO bit-bang UART on P9.04 (3.3 V)
 *
 * UARTE peripherals cannot route to GPIO port 9 on the nRF54H20
 * (confirmed: uart120, uart130, uart131, uart136 all fail on P9).
 * GPIO output works fine, so we bit-bang 9600-baud UART in software.
 *
 * CAN120 disabled to free P9.04/P9.05.
 */

&gpio9 {
	status = "okay";
};

&can120 {
	status = "disabled";
};
```

## src/main.c
```c
/*
 * Ultimate Flipboard — APP core (nRF54H20 cpuapp)
 *
 * Reads four GPIO buttons and maintains a two-team scoreboard.
 * Output goes to the console (RTT or UART) for now; the flipdots
 * display driver will replace print_score() later.
 *
 * Button layout (nRF54H20DK):
 *   BTN1 (sw0) — Team A +1
 *   BTN2 (sw1) — Team B +1
 *   BTN3 (sw2) — Undo: Team A −1
 *   BTN4 (sw3) — Reset both scores
 */

#include <zephyr/kernel.h>
#include <zephyr/drivers/gpio.h>
#include <zephyr/logging/log.h>

#include "scoreboard.h"
#include "flipdots.h"

LOG_MODULE_REGISTER(app, LOG_LEVEL_INF);

/* ── P9 GPIO test mode ──────────────────────────────────────────────────── */
/* Set to 1 to run a GPIO square-wave on P9.04 instead of normal app.      */
#define P9_GPIO_TEST 0

#if P9_GPIO_TEST
#define P9_TEST_PIN  4   /* P9.04 */
#define P7_TEST_PIN  7   /* P7.07 — known-working reference */
static const struct device *gpio9_dev = DEVICE_DT_GET_OR_NULL(DT_NODELABEL(gpio9));
static const struct device *gpio7_dev = DEVICE_DT_GET_OR_NULL(DT_NODELABEL(gpio7));
#endif

/* ── Score state ─────────────────────────────────────────────────────────── */

static scoreboard_t sb;

/* ── Flipdots test mode ──────────────────────────────────────────────────── */

#define TEST_MODE_INTERVAL_MS 300  /* ~3.3 Hz flip rate */

static flipdots_fb_t test_fb;
static bool test_is_white;
static struct k_work_delayable test_work;

static void test_mode_update(struct k_work *work)
{
	ARG_UNUSED(work);

	/* Toggle state */
	test_is_white = !test_is_white;

	/* Fill or clear framebuffer */
	if (test_is_white) {
		flipdots_fill(test_fb);
	} else {
		flipdots_clear(test_fb);
	}

	/* Send frame (broadcast address 0xFF) */
	int ret = flipdots_send_frame(0xFF, test_fb, true);
	if (ret != 0) {
		LOG_WRN("Failed to send flipdots frame: %d", ret);
	}

	/* Reschedule for next flip */
	k_work_schedule(&test_work, K_MSEC(TEST_MODE_INTERVAL_MS));
}

static void print_score(void)
{
	LOG_INF("Score │ Team A: %2d  │  Team B: %2d", sb.score_a, sb.score_b);
	/* TODO: drive the flipdots display here */
}

/* ── Button definitions ──────────────────────────────────────────────────── */

static const struct gpio_dt_spec btn_inc_a = GPIO_DT_SPEC_GET(DT_ALIAS(sw0), gpios);
static const struct gpio_dt_spec btn_inc_b = GPIO_DT_SPEC_GET(DT_ALIAS(sw1), gpios);
static const struct gpio_dt_spec btn_dec_a = GPIO_DT_SPEC_GET(DT_ALIAS(sw2), gpios);
static const struct gpio_dt_spec btn_reset = GPIO_DT_SPEC_GET(DT_ALIAS(sw3), gpios);

/* ── Debounce ────────────────────────────────────────────────────────────── */

#define DEBOUNCE_MS 50

struct btn_state { int64_t last_ms; };
static struct btn_state st_inc_a, st_inc_b, st_dec_a, st_reset;

static bool debounce(struct btn_state *s)
{
	int64_t now = k_uptime_get();

	if ((now - s->last_ms) < DEBOUNCE_MS) {
		return false;
	}
	s->last_ms = now;
	return true;
}

/* ── GPIO callbacks ──────────────────────────────────────────────────────── */

static struct gpio_callback cb_inc_a, cb_inc_b, cb_dec_a, cb_reset;

static void on_inc_a(const struct device *dev, struct gpio_callback *cb,
		     uint32_t pins)
{
	ARG_UNUSED(dev); ARG_UNUSED(cb); ARG_UNUSED(pins);
	if (!debounce(&st_inc_a)) return;
	scoreboard_inc_a(&sb);
	print_score();
}

static void on_inc_b(const struct device *dev, struct gpio_callback *cb,
		     uint32_t pins)
{
	ARG_UNUSED(dev); ARG_UNUSED(cb); ARG_UNUSED(pins);
	if (!debounce(&st_inc_b)) return;
	scoreboard_inc_b(&sb);
	print_score();
}

static void on_dec_a(const struct device *dev, struct gpio_callback *cb,
		     uint32_t pins)
{
	ARG_UNUSED(dev); ARG_UNUSED(cb); ARG_UNUSED(pins);
	if (!debounce(&st_dec_a)) return;
	scoreboard_dec_a(&sb);
	print_score();
}

static void on_reset(const struct device *dev, struct gpio_callback *cb,
		     uint32_t pins)
{
	ARG_UNUSED(dev); ARG_UNUSED(cb); ARG_UNUSED(pins);
	if (!debounce(&st_reset)) return;
	scoreboard_reset(&sb);
	LOG_INF("Scoreboard reset");
	print_score();
}

/* ── Setup helper ────────────────────────────────────────────────────────── */

static int setup_button(const struct gpio_dt_spec *btn,
			struct gpio_callback *cb,
			gpio_callback_handler_t handler)
{
	int ret;

	if (!gpio_is_ready_dt(btn)) {
		LOG_ERR("GPIO not ready: %s", btn->port->name);
		return -ENODEV;
	}
	ret = gpio_pin_configure_dt(btn, GPIO_INPUT);
	if (ret) return ret;

	ret = gpio_pin_interrupt_configure_dt(btn, GPIO_INT_EDGE_TO_ACTIVE);
	if (ret) return ret;

	gpio_init_callback(cb, handler, BIT(btn->pin));
	gpio_add_callback(btn->port, cb);
	return 0;
}

/* ── Entry point ─────────────────────────────────────────────────────────── */

int main(void)
{
	int ret;

	LOG_INF("Ultimate Flipboard starting");

#if P9_GPIO_TEST
	/* ── GPIO square-wave test on P9.04 + P7.07 (reference) ────────── */
	{
		bool p9_ok = gpio9_dev && device_is_ready(gpio9_dev);
		bool p7_ok = gpio7_dev && device_is_ready(gpio7_dev);

		if (p9_ok) {
			gpio_pin_configure(gpio9_dev, P9_TEST_PIN, GPIO_OUTPUT_HIGH);
			LOG_INF("P9.%02d ready (3.3 V rail)", P9_TEST_PIN);
		} else {
			LOG_ERR("gpio9 device not ready!");
		}
		if (p7_ok) {
			gpio_pin_configure(gpio7_dev, P7_TEST_PIN, GPIO_OUTPUT_HIGH);
			LOG_INF("P7.%02d ready (1.8 V reference)", P7_TEST_PIN);
		} else {
			LOG_ERR("gpio7 device not ready!");
		}

		LOG_INF("Toggling both pins at ~500 Hz — probe P9.04 and P7.07");
		while (true) {
			if (p9_ok) {
				gpio_pin_toggle(gpio9_dev, P9_TEST_PIN);
			}
			if (p7_ok) {
				gpio_pin_toggle(gpio7_dev, P7_TEST_PIN);
			}
			k_busy_wait(1000);  /* 1 ms half-period → ~500 Hz */
		}
	}
#endif

	scoreboard_init(&sb);

	/* Initialize flipdots driver */
	ret = flipdots_init();
	if (ret == 0) {
		/* Start automatic test mode */
		test_is_white = false;
		k_work_init_delayable(&test_work, test_mode_update);
		k_work_schedule(&test_work, K_MSEC(TEST_MODE_INTERVAL_MS));
		LOG_INF("Flipdots test mode started");
	} else {
		LOG_WRN("Flipdots initialization failed: %d (test mode disabled)", ret);
	}

	setup_button(&btn_inc_a, &cb_inc_a, on_inc_a);
	setup_button(&btn_inc_b, &cb_inc_b, on_inc_b);
	setup_button(&btn_dec_a, &cb_dec_a, on_dec_a);
	setup_button(&btn_reset, &cb_reset, on_reset);

	LOG_INF("Ready — BTN1=A+  BTN2=B+  BTN3=A−  BTN4=reset");
	print_score();

	while (true) {
		k_sleep(K_FOREVER);
	}

	return 0;
}
```

## include/flipdots.h
```c
/*
 * Flipdots 7x28 display driver
 *
 * Provides a framebuffer API for controlling a 7×28 AlfaZeta flipdots panel
 * over RS485 serial protocol.
 */

#pragma once

#include <stdint.h>
#include <stdbool.h>

/* 7×28 framebuffer: 28 bytes, one per column */
typedef uint8_t flipdots_fb_t[28];

/* Clear all dots (all black/hidden) */
void flipdots_clear(flipdots_fb_t buf);

/* Fill all dots (all white/visible) */
void flipdots_fill(flipdots_fb_t buf);

/* Set individual pixel state */
void flipdots_set_pixel(flipdots_fb_t buf, uint8_t x, uint8_t y, bool on);

/* Send frame to display over serial */
int flipdots_send_frame(uint8_t addr, const flipdots_fb_t buf, bool refresh_now);

/* Initialize the flipdots driver (must be called before sending frames) */
int flipdots_init(void);
```

## include/scoreboard.h
```c
/*
 * Scoreboard state machine — no Zephyr or hardware dependencies.
 * This lives here so it can be unit-tested independently of main.c.
 */

#pragma once

typedef struct {
	int score_a;
	int score_b;
} scoreboard_t;

void scoreboard_init(scoreboard_t *sb);
void scoreboard_inc_a(scoreboard_t *sb);
void scoreboard_inc_b(scoreboard_t *sb);
void scoreboard_dec_a(scoreboard_t *sb);  /* floors at 0 */
void scoreboard_dec_b(scoreboard_t *sb);  /* floors at 0 */
void scoreboard_reset(scoreboard_t *sb);
```

## include/scoreboard_events.h
```c
/*
 * Shared IPC message definitions between APP core and PPR core.
 * Keep this file dependency-free so it can also be used in host-side tests.
 */

#pragma once

#include <stdint.h>

enum score_cmd {
	SCORE_INC_A = 0, /* Team A scored a point      */
	SCORE_INC_B = 1, /* Team B scored a point      */
	SCORE_DEC_A = 2, /* Undo: decrement Team A     */
	SCORE_DEC_B = 3, /* Undo: decrement Team B     */
	SCORE_RESET = 4, /* Reset both scores to zero  */
};

/* Fixed-size IPC payload (4 bytes, naturally aligned). */
struct score_event {
	uint8_t cmd;         /* enum score_cmd              */
	uint8_t reserved[3]; /* pad to 4 bytes, must be 0  */
};
```

## src/flipdots.c
```c
/*
 * Flipdots 7×28 display driver implementation
 *
 * Uses GPIO bit-bang UART TX on P9.04 because the nRF54H20 UARTE
 * peripherals cannot route output to GPIO port 9 pins (confirmed
 * by testing uart120, uart130, uart131, uart136 — all produce a
 * flat line on P9, while GPIO toggle works fine at 3.3 V).
 *
 * 9600 baud, 8-N-1, via RS-485 breakout board.
 */

#include "flipdots.h"

#include <string.h>

#include <zephyr/kernel.h>
#include <zephyr/device.h>
#include <zephyr/drivers/gpio.h>
#include <zephyr/logging/log.h>

LOG_MODULE_REGISTER(flipdots, LOG_LEVEL_DBG);

/* ── Software UART TX on P9.04 ──────────────────────────────────────────── */

#define SW_UART_TX_PIN   4          /* P9.04 */
#define SW_UART_BIT_US   104        /* 1 000 000 / 9600 ≈ 104.17 µs */

static const struct device *gpio9_dev = DEVICE_DT_GET_OR_NULL(DT_NODELABEL(gpio9));

/**
 * Transmit one byte using bit-bang UART (8-N-1, LSB first).
 * Interrupts are locked for the duration (~1.04 ms) to keep
 * timing within the ±3 % tolerance that UART receivers allow.
 */
static void sw_uart_tx_byte(uint8_t byte)
{
	unsigned int key = irq_lock();

	/* Start bit — LOW */
	gpio_pin_set_raw(gpio9_dev, SW_UART_TX_PIN, 0);
	k_busy_wait(SW_UART_BIT_US);

	/* 8 data bits, LSB first */
	for (int i = 0; i < 8; i++) {
		gpio_pin_set_raw(gpio9_dev, SW_UART_TX_PIN, (byte >> i) & 1);
		k_busy_wait(SW_UART_BIT_US);
	}

	/* Stop bit — HIGH */
	gpio_pin_set_raw(gpio9_dev, SW_UART_TX_PIN, 1);
	k_busy_wait(SW_UART_BIT_US);

	irq_unlock(key);
}

/* ── Protocol constants ─────────────────────────────────────────────────── */

#define FRAME_START 0x80
#define FRAME_END   0x8F
#define CMD_7X28_REFRESH 0x83
#define CMD_7X28_BUFFERED 0x84
#define CMD_REFRESH_ALL 0x82

#define DISPLAY_WIDTH 28
#define DISPLAY_HEIGHT 7

/* ── Framebuffer helpers ────────────────────────────────────────────────── */

void flipdots_clear(flipdots_fb_t buf)
{
	memset(buf, 0, DISPLAY_WIDTH);
}

void flipdots_fill(flipdots_fb_t buf)
{
	/* Set bits 0-6 (all 7 dots visible), bit 7 must be 0 */
	memset(buf, 0x7F, DISPLAY_WIDTH);
}

void flipdots_set_pixel(flipdots_fb_t buf, uint8_t x, uint8_t y, bool on)
{
	if (x >= DISPLAY_WIDTH || y >= DISPLAY_HEIGHT) {
		return;
	}

	if (on) {
		buf[x] |= (1u << y);
	} else {
		buf[x] &= ~(1u << y);
	}

	/* Ensure bit 7 is always 0 */
	buf[x] &= 0x7F;
}

/* ── Frame TX ───────────────────────────────────────────────────────────── */

static int send_frame_bytes(const uint8_t *data, size_t len)
{
	if (gpio9_dev == NULL || !device_is_ready(gpio9_dev)) {
		LOG_ERR("GPIO9 device not ready");
		return -ENODEV;
	}

	LOG_HEXDUMP_DBG(data, len, "TX frame");

	for (size_t i = 0; i < len; i++) {
		sw_uart_tx_byte(data[i]);
	}

	return 0;
}

int flipdots_send_frame(uint8_t addr, const flipdots_fb_t buf, bool refresh_now)
{
	uint8_t frame[1 + 1 + 1 + DISPLAY_WIDTH + 1]; /* start + cmd + addr + data + end */
	size_t idx = 0;
	uint8_t cmd;

	if (gpio9_dev == NULL || !device_is_ready(gpio9_dev)) {
		LOG_ERR("GPIO9 device not ready");
		return -ENODEV;
	}

	/* Build frame */
	frame[idx++] = FRAME_START;

	if (refresh_now) {
		cmd = CMD_7X28_REFRESH;
	} else {
		cmd = CMD_7X28_BUFFERED;
	}
	frame[idx++] = cmd;
	frame[idx++] = addr;

	/* Copy data bytes */
	memcpy(&frame[idx], buf, DISPLAY_WIDTH);
	idx += DISPLAY_WIDTH;

	frame[idx++] = FRAME_END;

	return send_frame_bytes(frame, idx);
}

/* ── Init ───────────────────────────────────────────────────────────────── */

int flipdots_init(void)
{
	if (gpio9_dev == NULL) {
		LOG_ERR("Flipdots GPIO9 device not found");
		return -ENODEV;
	}

	if (!device_is_ready(gpio9_dev)) {
		LOG_ERR("Flipdots GPIO9 device not ready");
		return -ENODEV;
	}

	/* Configure TX pin: output, idle HIGH (UART idle state) */
	int ret = gpio_pin_configure(gpio9_dev, SW_UART_TX_PIN, GPIO_OUTPUT_HIGH);
	if (ret) {
		LOG_ERR("Failed to configure P9.%02d: %d", SW_UART_TX_PIN, ret);
		return ret;
	}

	LOG_INF("Flipdots driver initialized (bit-bang UART on P9.%02d, 9600 baud)",
		SW_UART_TX_PIN);
	return 0;
}
```

## src/scoreboard.c
```c
#include "scoreboard.h"

void scoreboard_init(scoreboard_t *sb)
{
	sb->score_a = 0;
	sb->score_b = 0;
}

void scoreboard_inc_a(scoreboard_t *sb) { sb->score_a++; }
void scoreboard_inc_b(scoreboard_t *sb) { sb->score_b++; }

void scoreboard_dec_a(scoreboard_t *sb)
{
	if (sb->score_a > 0) sb->score_a--;
}

void scoreboard_dec_b(scoreboard_t *sb)
{
	if (sb->score_b > 0) sb->score_b--;
}

void scoreboard_reset(scoreboard_t *sb)
{
	sb->score_a = 0;
	sb->score_b = 0;
}
```
